## Config.in
```kconfig
#
# For a description of the syntax of this configuration file,
# see scripts/config-language.txt.
#

menu "PIC Speeds"
config BUS_DIV
	int "The bus divisor"
	default 1
	help
	  The bus divisor

config BUS_KHZ
	int "The bus speed in KHZ"
	default 80000
	help
	  The bus speed in KHZ.  This is determined by the oscillators.

config CPU_IDIV
	int "The CPU divisor"
	default 2
	help
	  The CPU Divisor

config CPU_KHZ
	int "The speed of the CPU, in KHz"
	default 80000
	
config CPU_MUL
	int "The CPU multiplier"
	default 20

config CPU_ODIV
	int "CPU ODIV"
	default 1

config CRYSTAL
	int "Crystal speed"
	default 8

endmenu

menu "Configuration register options"
endmenu

menu "TTY Options"
config CONSOLE_DEVICE
	string "The default console device"
	default "tty1"


endmenu

menu "Exec options"
config EXEC_AOUT
	bool "Execute a.out format executables"
	default y

config EXEC_ELF
	bool "Execute ELF format executables"
	default y

config EXEC_SCRIPT
	bool "Execute script files"
	default y

endmenu

menu "Drivers"
config GPIO_ENABLED
	bool "Enable GPIO driver"
	default y
endmenu

config KERNEL
	bool "Build as a kernel?"
	default y
	help
	  You really probably don't want to change this.  That would be a 
	  stupid idea.


config String_Example
	string "String Example"
	default "abcdef"
	
config INT_Example
	int "Support int file"
	depends on  Depend_1_example && Depend_2_example 
	default 10
	help
	  INT_Example: default = 10.
	  
config Bool_1_Example
	bool "Bool 1 Example"
	depends on  Depend_1_example || Depend_2_example
	default n
	help
	  Bool_1_Example: default false.

config Bool_2_Example
	bool "Bool 2 Example"
	depends on Depend_1_example || Depend_2_example
	default n
	select Bool_1_Example


config Depend_1_example
	bool "Depend 1 example"
	default n



config Depend_2_example
	bool "Depend 2 example"
	default n
	help
	  Even small dogs may be forbidden on public transport and in shopping 
	  malls and supermarkets.

	  Note Other provisions will address where dogs can be walked and who's 
	  responsible 
	  for any messes they leave behind.
	  
choice
	prompt "Multi Selection"
	default OPTION_1


config OPTION_1
	bool "OPTION 1"

config OPTION_2
	bool "OPTION 2"

config OPTION_3
	bool "OPTION 3"

endchoice
comment "Applets"
```
